## west.yml
```yaml
manifest:
  version: 0.8

  projects:
    - name: zephyr
      url: https://github.com/zephyrproject-rtos/zephyr
      revision: zephyr-v3.3.0
      import:
        file: west.yml
        path-prefix: deps
        name-allowlist:
          - cmsis
          - hal_stm32
  self:
    path: app
```
